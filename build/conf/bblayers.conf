## build/conf/bblayers.conf
```bitbake
# POKY_BBLAYERS_CONF_VERSION is increased each time build/conf/bblayers.conf
# changes incompatibly
POKY_BBLAYERS_CONF_VERSION = "2"

BBPATH = "${TOPDIR}"
BBFILES ?= ""
BBLAYERS ?= " \
  /home/v-gadgil8864/anup/docker-yocto/poky/meta \
  /home/v-gadgil8864/anup/docker-yocto/poky/meta-poky \
  /home/v-gadgil8864/anup/docker-yocto/poky/meta-yocto-bsp \
  /home/v-gadgil8864/anup/docker-yocto/poky/meta-openembedded/meta-oe \
  "
```
